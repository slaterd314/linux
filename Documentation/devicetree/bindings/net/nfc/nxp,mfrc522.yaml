## Documentation/devicetree/bindings/net/nfc/nxp,mfrc522.yaml
```yaml
# nxp,mfrc522.yaml
$id: http://devicetree.org/schemas/net/nfc/nxp,mfrc522.yaml#
$schema: "http://devicetree.org/meta-schemas/core.yaml#"
title: NXP MFRC522 NFC Reader

maintainers:
  - name: "Daniel R. Slater"
    email: "slaterd314@gmail.com"

description: |-
  MFRC522 is an NFC reader IC from NXP supporting ISO/IEC 14443 A/MIFARE cards.
  It supports SPI, I2C, and UART interfaces.

properties:
  compatible:
    enum:
      - nxp,mfrc522

  reg:
    maxItems: 1
    description: Address of the device on the bus (chip-select, I2C address, UART port).

  spi-max-frequency:
    description: Maximum SPI clock frequency in Hz.

  reset-gpios:
    description: Optional GPIO used to reset the device via NRSTPD.

  interrupts:
    description: Optional interrupt line.

required:
  - compatible
  - reg

examples:
  - |
    spi {
        #address-cells = <1>;
        #size-cells = <0>;

        mfrc522@0 {
            compatible = "nxp,mfrc522";
            reg = <0>;
            spi-max-frequency = <10000000>;
            reset-gpios = <&gpio1 5 GPIO_ACTIVE_LOW>;
        };
    };

  - |
    i2c {
        #address-cells = <1>;
        #size-cells = <0>;

        mfrc522@28 {
            compatible = "nxp,mfrc522";
            reg = <0x28>;
            reset-gpios = <&gpio2 3 GPIO_ACTIVE_LOW>;
        };
    };

  - |
    serial {
        mfrc522@0 {
            compatible = "nxp,mfrc522";
            reg = <0>;
            reset-gpios = <&gpio3 7 GPIO_ACTIVE_LOW>;
        };
    };
```

## drivers/nfc/mfrc522/Kconfig
```kconfig
# Kconfig
config MFRC522
    tristate "MFRC522 NFC Reader support"
    depends on SPI || I2C || SERIAL_DEV_BUS || COMPILE_TEST
    select CRC7
    help
      Support for the NXP MFRC522 NFC reader chip.
      This driver provides access to the MFRC522 via SPI, I2C, or UART.
      It supports optional reset GPIO, power management, and debug instrumentation.
      To compile this driver as a module, choose M here: the module will be called mfrc522.

config MFRC522_SPI
    tristate "MFRC522 SPI bus support"
    depends on MFRC522 && SPI
    help
      SPI bus front-end for MFRC522 driver.

config MFRC522_I2C
    tristate "MFRC522 I2C bus support"
    depends on MFRC522 && I2C
    help
      I2C bus front-end for MFRC522 driver.

config MFRC522_UART
    tristate "MFRC522 UART bus support"
    depends on MFRC522 && SERIAL_DEV_BUS
    help
      UART bus front-end for MFRC522 driver.

config MFRC522_DEBUG
    bool "Enable debug instrumentation for MFRC522"
    depends on MFRC522
    help
      Enable verbose debug output for MFRC522 driver.

config MFRC522_PM
    bool "Enable runtime power management for MFRC522"
    depends on MFRC522
    help
      Enable support for runtime PM and suspend/resume integration.

config MFRC522_RESET_GPIO
    bool "Enable reset GPIO support for MFRC522"
    depends on MFRC522 && GPIOLIB
    help
      Enable optional reset GPIO handling for MFRC522.

config MFRC522_KUNIT_TEST
    tristate "KUnit tests for MFRC522" if !KUNIT_ALL_TESTS
    depends on KUNIT
    select MFRC522
    default KUNIT_ALL_TESTS
    help
      Enable KUnit-based unit tests that exercise the MFRC522 core helper
      routines (FIFO operations, IRQ helpers, etc.). Select this option when
      building with KUnit to validate the driver without requiring MFRC522
      hardware.
```
